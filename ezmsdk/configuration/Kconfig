## ezmsdk/configuration/Kconfig
```kconfig
mainmenu "Configuration for the Embedded Easy SDK"

config APP_VERSION_NUMBER
    string "Application revision"
    default "00.00.00"

config SDK_VERSION_NUMBER
    string "SDK revision"
    default "00.00.99"

choice
    prompt  "Choosing supported platform"
    config NO_CHIP
        bool "no platform"
    config WIN
        bool "Windows"
    config LINUX
        bool "Linux"
    config ESP32
        bool "ESP32"
    config STM32
        bool "STM32"
endchoice

config UNITY_UNIT_TEST
    bool "enable UNITY_UNIT_TEST support"
    help
        Enable the unity unit test platform

config EMBEDDED_EMULATOR
    bool "enable EMBEDDED_EMULATOR support"
    depends on BIN_PARSER && EZ_QUEUE
    help
        Enable the embedded emulator application

comment "EMBEDDED_EMULATOR support disable. Depend on LOGBIN_PARSER and EZ_QUEUE"
    depends on !BIN_PARSER || !EZ_QUEUE

menu "Helper modules"

config HELPER_LINKEDLIST
    bool "Enable HELPER_LINKEDLIST support"
    default y
    help
        Linked list implementation. One of the most important module.
        Losts of modules based on it to operate.

menu "LOGGING configuration"    
config LOGGING
    bool "Enable LOGGING support"
    help
        Print debug output on the terminal. It supports multi-level features
        such as: multi-level logging, module name, function name and line,
        color

config USING_COLOR
    bool "Enable USING_COLOR for LOGGING"
    default y
    depends on LOGGING
    help
        Activate color support for logging module
endmenu

config HELPER_HEXDUMP
    bool "Enable HELPER_HEXDUMP support"
    depends on LOGGING

comment "HELPER_HEXDUMP support disable. Depend on LOGGING"
    depends on !LOGGING

config RING_BUFFER
    bool "Enable RING_BUFFER support"

config HELPER_ASSERT
    bool "Enable HELPER_ASSERT support"

config EVENT_NOTIFIER
    bool "Enable EVENT_NOTIFIER support"
    depends on HELPER_LINKEDLIST
    help
        This module allows events can be notified between modules based on pub/sub
        pattern

comment "EVENT_NOTIFIER support disable. Depend on HELPER_LINKEDLIST"
    depends on !HELPER_LINKEDLIST

menu "STCMEM configuration"    
config STCMEM
    bool "Enable STCMEM support"
    depends on HELPER_LINKEDLIST
    help
        Static memory allocation. This modules allows the developers to allocate
        memory on a fixed memory buffer.

comment "STCMEM support disable. Depend on HELPER_LINKEDLIST"
    depends on !HELPER_LINKEDLIST

config NUM_OF_MEM_BLOCK
    int "NUM_OF_MEM_BLOCK"
    default 128
    depends on STCMEM
endmenu

config SYSTEM_ERROR
    bool "Enable SYSTEM_ERROR notification"
    help
        This module allows the errors can be managed and handled centralized

menu "EZ_QUEUE configuration"
config EZ_QUEUE
    bool "Enable EZ_QUEUE support"
    help
        this module is the implementation of the queue data structure

config EZ_QUEUE_TEST
    bool "Enable EZ_QUEUE unit test support"
    depends on UNITY_UNIT_TEST
    help
        Enable unit test for EZ_QUEUE module. Note that only one test can be
        activated at a time

comment "EZ_QUEUE_TEST support disable. Depend on UNITY_UNIT_TEST"
    depends on !UNITY_UNIT_TEST

endmenu

endmenu

menu "Driver modules"

menu "HAL_UART configuration"
config HAL_UART
    bool "Enable HAL_UART support"
    help
        Hardware abstaction layer for UART interface. It provides a common api
        to interact with the hardware UART bus

if WIN && HAL_UART
config SIM_UART
    bool "Enable SIM_UART support"
    help
        simulated uart peripheral for windows, based on stdio

config VIRTUAL_COM
    bool "Enable VIRTUAL_COM support"
    help
        Virtual com interface for windows
endif

endmenu

menu "FLASH_SIM configuration"
config FLASH_SIM
    bool "Enable FLASH_SIM support"
    depends on WIN
    help
        simulated non volatile memory

comment "FLASH_SIM support disable. Depend on WIN"
    depends on !WIN

if FLASH_SIM
config NUM_OF_FLASH
    int "number of supported flash"
    default 1

config FLASH_LOCATION
    string "location of the file to simulate flash data"
    depends on FLASH_SIM
    help
        The location to create the file to simulate flash data. It must be an 
        absolute path to guarantee normal operation
endif
endmenu

config WIFI_CONTROLLER
    bool "Enable WIFI_CONTROLLER support"

config MQTT
    bool "Enable MQTT support"
endmenu

menu "Application modules"

menu "CLI configuration"
config CLI
    bool "Enable CLI support"
    depends on HAL_UART
    help
        Command Line Interface

comment "CLI support disable. Depend on HAL_UART"
    depends on !HAL_UART

if CLI
config NUM_OF_ARGUMENT
    int "NUM_OF_ARGUMENT"
    default 4

config NUM_OF_CMD
    int "NUM_OF_CMD"
    default 10
endif

endmenu

config SCHEDULER
    bool "(Legacy)Enable SCHEDULER support"

config SMALLOC
    bool "(Legacy)Enable SMALLOC support"
    depends on HELPER_LINKEDLIST

comment "(Legacy)SMALLOC support disable. Depend on HELPER_LINKEDLIST"
    depends on !HELPER_LINKEDLIST

menu "BIN_PARSER configuration"
config BIN_PARSER
    bool "Enable BIN_PARSER support"
    depends on STCMEM
    help
        This module provides a generic way to parse data in binary format
        and reponse to the data

comment "BIN_PARSER support disable. Depend on STCMEM"
    depends on !STCMEM

if BIN_PARSER
config PAYLOAD_MAX_SIZE
    int "PAYLOAD_MAX_SIZE"
    default 32

config CRC_SIZE
    int "CRC_SIZE"
    default 2
endif
endmenu

config RPC
    bool "Enable Remote Procedure Call (RPC) support"
    depends on STCMEM
    help
        Implementation of remote procedure call. Note this is a propritary
        module and it does not follow any standard

comment "RPC support disable. Depend on STCMEM"
    depends on !STCMEM

menu "IPC configuration"
config IPC
    bool "Enable IPC support"
    depends on HELPER_LINKEDLIST
    help
        This module provides a way for process to communicate with each other

comment "IPC support disable. Depend on HELPER_LINKEDLIST"
    depends on !HELPER_LINKEDLIST

if IPC
config NUM_OF_IPC_INSTANCE
    int "NUM_OF_IPC_INSTANCE"
    default 5

config USING_MODULE_NAME
    bool  "USING_MODULE_NAME"
endif
endmenu

menu "KERNEL configuration"
config KERNEL
    bool "Enable KERNEL support"
    depends on HELPER_LINKEDLIST
    help
        This module provides a way to scheduling and executing tasks

comment "KERNEL support disable. Depend on HELPER_LINKEDLIST"
    depends on !HELPER_LINKEDLIST

if KERNEL
config NUM_OF_PROCESS
    int "NUM_OF_PROCESS"
    default 5
endif
endmenu

config DRIVERINF
    bool "Enable DRIVERINF support"
    depends on HELPER_LINKEDLIST
    help
        This modules provides the methods to initializing, managing HAL drivers
        component

comment "DRIVERINF support disable. Depend on HELPER_LINKEDLIST"
    depends on !HELPER_LINKEDLIST

config EZM_PRINTF
    bool "Enable EZM_PRINTF support"


config DATA_MODEL
    bool "Enable DATA_MODEL support"
    depends on HELPER_LINKEDLIST && EVENT_NOTIFIER
    help
        This module provides methods to manage data in a centralized way, to notify
        when data is changing

comment "DATA_MODEL support disable. Depend on HELPER_LINKEDLIST"
    depends on !HELPER_LINKEDLIST || !EVENT_NOTIFIER

config STATEMACHINE
    bool "Enable state machine module"
    help
        This modules is the implementation for the state machine

endmenu
```
